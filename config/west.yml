## config/west.yml
```yaml
manifest:
  remotes:
    - name: zmkfirmware
      url-base: https://github.com/zmkfirmware
    - name: petejohanson
      url-base: https://github.com/petejohanson
  projects:
    - name: zmk
      remote: zmkfirmware   
      #revision: zephyr/3.3-update
      #revision: power/domains-and-device-runtime
      revision: main
      import: app/west.yml
  self:
    path: config
```
